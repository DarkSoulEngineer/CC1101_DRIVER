## components/cc1101/Kconfig
```kconfig
menu "CC1101 Radio Configuration"

    choice CC1101_FREQ_BAND
        prompt "Frequency band"
        default CC1101_FREQ_433
        help
            Select the RF frequency band.

        config CC1101_FREQ_433
            bool "433 MHz ISM band"
        config CC1101_FREQ_868
            bool "868 MHz SRD band"
        config CC1101_FREQ_915
            bool "915 MHz ISM band"
    endchoice

    config CC1101_FREQ_HZ
        int "Frequency override (Hz, 0 = use band default)"
        default 0
        help
            Override the exact frequency in Hz.
            0 = use band default (433920000 / 868300000 / 915000000).

    choice CC1101_MODULATION
        prompt "Modulation format"
        default CC1101_MOD_2FSK
        help
            RF modulation scheme.

        config CC1101_MOD_2FSK
            bool "2-FSK"
        config CC1101_MOD_GFSK
            bool "GFSK"
        config CC1101_MOD_ASK_OOK
            bool "ASK/OOK"
        config CC1101_MOD_4FSK
            bool "4-FSK"
        config CC1101_MOD_MSK
            bool "MSK"
    endchoice

    config CC1101_DATARATE
        int "Datarate (bps)"
        default 2400
        range 600 500000
        help
            Over-the-air datarate in bits per second.

    config CC1101_DEVIATION
        int "Frequency deviation (register 0-7)"
        default 4
        range 0 7
        help
            DEVIATN register value (0-7).
            Deviation = (8 + M) * 2^E * fref / 2^17
            where M = deviation & 0x07, E = (deviation >> 4) & 0x07.
            Common: 3=24kHz, 4=24kHz, 5=47kHz.

    config CC1101_CHANNEL_BW
        int "Channel bandwidth (MDMCFG4 BW bits, 0-60)"
        default 12
        range 0 60
        help
            Channel bandwidth portion of MDMCFG4 register.
            Value = (CHANBW_E << 4) | CHANBW_M, where E,M are 0-3.
            BW = 26MHz / (8 * (4 + M) * 2^E).
            0x00=58kHz, 0x30=81kHz, 0x40=101kHz, 0x80=128kHz,
            0x90=162kHz, 0xB0=203kHz, 0xC0=258kHz.

    config CC1101_SYNC_MODE
        int "Sync word mode (0-7)"
        default 2
        range 0 7
        help
            Sync word detection mode. 2=16/16 recommended.

    config CC1101_SYNC_WORD
        int "Sync word (16-bit decimal)"
        default 45022
        help
            16-bit sync word sent MSB first. 45022 = 0xAFDE.

    config CC1101_PREAMBLE_BYTES
        int "Preamble bytes"
        default 4
        range 0 32
        help
            Number of preamble bytes (0, 2, 4, 8, 12, 16, 20, 24, 28, 32).

    choice CC1101_PKT_MODE
        prompt "Packet mode"
        default CC1101_PKT_FIXED
        help
            Packet length mode.

        config CC1101_PKT_FIXED
            bool "Fixed length"
        config CC1101_PKT_VARIABLE
            bool "Variable length"
        config CC1101_PKT_INFINITE
            bool "Infinite length (async)"
    endchoice

    config CC1101_CRC_ENABLE
        bool "Enable CRC"
        default n

    config CC1101_WHITENING
        bool "Enable whitening"
        default n

    config CC1101_APPEND_STATUS
        bool "Append status bytes (RSSI + CRC)"
        default n

    choice CC1101_PA_PRESET
        prompt "TX power"
        default CC1101_PA_10dBm
        help
            PA output power level.

        config CC1101_PA_neg30dBm
            bool "-30 dBm"
        config CC1101_PA_neg20dBm
            bool "-20 dBm"
        config CC1101_PA_neg15dBm
            bool "-15 dBm"
        config CC1101_PA_neg10dBm
            bool "-10 dBm"
        config CC1101_PA_0dBm
            bool "0 dBm"
        config CC1101_PA_5dBm
            bool "+5 dBm"
        config CC1101_PA_7dBm
            bool "+7 dBm"
        config CC1101_PA_10dBm
            bool "+10 dBm"
        config CC1101_PA_12dBm
            bool "+12 dBm"
    endchoice

    config CC1101_PA_VALUE
        int "PA table value (raw, 0 = use preset)"
        default 0
        range 0 199
        help
            Raw PA register value. If non-zero, overrides the preset above.
            0 = use preset selection.

    config CC1101_ISR_ENABLE
        bool "Enable GDO0 interrupt (TX done)"
        default n
        help
            Enable GPIO interrupt on GDO0 for TX completion.

endmenu
```

## components/hw_init/Kconfig
```kconfig
menu "CC1101 Hardware (Board Support)"

    menu "CC1101 Pinout"
        config CC1101_PIN_GDO0
            int "GDO0 pin"
            default 10
            range 0 48
            help
                GPIO pin connected to CC1101 GDO0 (interrupt / data output).

        config CC1101_PIN_GDO2
            int "GDO2 pin"
            default 11
            range 0 48
            help
                GPIO pin connected to CC1101 GDO2 (data output / clock).

        config CC1101_PIN_CS
            int "CS (chip select) pin"
            default 5
            range 0 48
            help
                GPIO pin connected to CC1101 CSN (active low chip select).

        config CC1101_PIN_SCK
            int "SCK (SPI clock) pin"
            default 15
            range 0 48
            help
                GPIO pin connected to CC1101 SCLK.

        config CC1101_PIN_MOSI
            int "MOSI pin"
            default 7
            range 0 48
            help
                GPIO pin connected to CC1101 MOSI (master out slave in).

        config CC1101_PIN_MISO
            int "MISO pin"
            default 6
            range 0 48
            help
                GPIO pin connected to CC1101 MISO (master in slave out).

        config CC1101_SPI_HZ
            int "SPI clock speed (Hz)"
            default 1000000
            range 100000 8000000
            help
                SPI clock frequency in Hz. CC1101 supports up to 10 MHz,
                recommend 1 MHz for reliability.
    endmenu

    menu "USB Interface (USB Serial/JTAG)"
        config USB_INTERFACE_USJ_TX_BUFFER_SIZE
            int "USB Serial/JTAG TX ring buffer size (bytes)"
            default 4096
            range 256 16384
            help
                Ring buffer size for the USB Serial/JTAG TX direction
                (data sent from device to host). Keep it well above the
                streaming chunk size (see sump_capture transport_write).

        config USB_INTERFACE_USJ_RX_BUFFER_SIZE
            int "USB Serial/JTAG RX ring buffer size (bytes)"
            default 256
            range 64 4096
            help
                Ring buffer size for the USB Serial/JTAG RX direction
                (data received from host).
    endmenu

endmenu
```

## components/hw_init/usb_interface/Kconfig
```kconfig
menu "USB Interface (USB Serial/JTAG)"

    config USB_INTERFACE_USJ_TX_BUFFER_SIZE
        int "USB Serial/JTAG TX ring buffer size (bytes)"
        default 4096
        range 256 16384
        help
            Ring buffer size for the USB Serial/JTAG TX direction
            (data sent from device to host). Keep it well above the
            streaming chunk size (see sump_capture transport_write).

    config USB_INTERFACE_USJ_RX_BUFFER_SIZE
        int "USB Serial/JTAG RX ring buffer size (bytes)"
        default 256
        range 64 4096
        help
            Ring buffer size for the USB Serial/JTAG RX direction
            (data received from host).

endmenu
```

## components/sump_capture/Kconfig
```kconfig
menu "SUMP Capture"

    choice SUMP_TRANSPORT
        prompt "OLS transport (serial interface)"
        default SUMP_TRANSPORT_USB
        help
            Select which serial interface carries the SUMP/OLS protocol.

            *** RECOMMENDED: USB Serial JTAG ***

            USB mode: OLS on USB Serial JTAG (typically COM7).
                      PulseView connects here via OLS driver.
                      Console on UART0 (typically COM6).

            UART mode: OLS on UART0 (typically COM6).
                       CAUTION: When PulseView opens a COM port it
                       asserts DTR/RTS, which on ESP32 dev boards are
                       wired to EN (reset) and BOOT.  This causes a
                       hardware reset.  The ROM bootloader then prints
                       boot text at 115200 baud, which PulseView reads
                       as garbage at 921600 baud and concludes nothing
                       is connected.  Use USB mode instead, or install
                       a 10uF cap between EN and GND to suppress the
                       reset.

            IMPORTANT: also change ESP Console setting to match:
              USB mode   -> CONFIG_ESP_CONSOLE_UART_DEFAULT (console on UART0)
              UART mode  -> CONFIG_ESP_CONSOLE_USB_SERIAL_JTAG (console on USB JTAG)

        config SUMP_TRANSPORT_USB
            bool "USB Serial JTAG (Recommended)"
            help
                OLS protocol uses USB Serial JTAG (typically COM7).
                This is the recommended mode because the native USB
                peripheral does not route through a USB-UART bridge,
                so opening the port never triggers a hardware reset.
                PulseView connects here via the OLS driver.
                IDF console routes to UART0 (typically COM6).

        config SUMP_TRANSPORT_UART
            bool "UART0 (DTR reset risk -- not recommended)"
            help
                OLS protocol uses UART0 (typically COM6).
                WARNING: PulseView will toggle DTR when opening this
                port, causing the ESP32 to reset.  The ROM bootloader
                boot text will then corrupt the SUMP handshake.  To
                use this mode you MUST either:
                  (a) install a 10uF capacitor on EN->GND, or
                  (b) use the DTR reset guard (CONFIG_SUMP_DTR_RESET_GUARD).
                USB Serial JTAG mode avoids this entirely.

    endchoice

    config SUMP_UART_BAUD
        int "UART console / fallback baud rate"
        default 15200
        range 9600 3000000
        help
            Baud rate used when the SUMP transport is set to UART0,
            and also the baud rate of the UART console in USB mode.

            When using USB Serial JTAG mode this controls the IDF
            console on UART0 (the "UART" port).  PulseView does NOT
            use this -- it talks over USB -- so it has no effect on the
            SUMP handshake in USB mode.

            When using UART0 mode this is the SUMP/OLS baud rate.
            MUST match the baud rate you select in PulseView.

    config SUMP_CLOCK_FREQ
        int "SUMP reference clock frequency (Hz)"
        default 240000000
        help
            Reference clock frequency for SUMP divider calculation.
            Sample rate = clock_freq / (divider + 1).

    config SUMP_MAX_SAMPLES
        int "Maximum samples per channel"
        default 100000
        range 1000 4000000
        help
            Maximum number of samples per channel in the capture buffer.
            With timer ISR, raw samples are packed 8 per byte in ISR.
            Memory = (MAX_SAMPLES / 8) * num_channels bytes.

    config SUMP_NUM_CHANNELS
        int "Number of SUMP channels (1 or 2)"
        default 2
        range 1 2
        help
            Number of channels to capture.
            1 = GDO0 only (demodulated async data).
            2 = GDO0 + GDO2 (configurable second signal).

    config SUMP_GDO2_MODE
        int "GDO2 output mode (IOCFG2 register value)"
        default 13
        range 0 47
        help
            CC1101 IOCFG2 output mode for the 2nd SUMP channel.
            Common values:
              0x06 = Sync word detect (packet timing reference)
              0x07 = CRC OK (data quality indicator)
              0x08 = PLL lock (carrier detect)
              0x0B = RSSI valid (signal presence)
              0x0D = Async data (raw demodulated bits, same as GDO0)
              0x2E = High-Z (disabled, 1-channel mode)

            The GDO2 GPIO pin is NOT a SUMP option: capture_init() is
            called with PIN_NUM_GDO2, which comes from CONFIG_CC1101_PIN_GDO2
            (hw_init.h / cc1101 Kconfig).  A former SUMP_GDO2_PIN option was
            removed -- it duplicated the cc1101 pin and was never read by
            the code, so changing it silently had no effect.

    config SUMP_DTR_RESET_GUARD
        bool "DTR/RTS reset guard (software)"
        default y
        help
            When PulseView opens a serial port it toggles DTR/RTS,
            which on many ESP32 dev boards resets the chip via the
            CH340/CP2102 bridge.  The ROM bootloader then prints boot
            text at 115200 baud that corrupts the SUMP handshake at
            921600 baud.  This guard drains the serial buffer for an
            extended period after boot to absorb the stale output.
            RECOMMENDED: use USB Serial JTAG mode instead -- it avoids
            the DTR reset entirely because it bypasses the bridge chip.

    config SUMP_DTR_GUARD_MS
        int "Guard drain time (ms)"
        default 3000
        range 500 10000
        depends on SUMP_DTR_RESET_GUARD
        help
            How long to drain the serial buffer after USB JTAG driver
            install, before entering the SUMP command loop.  The ROM
            bootloader prints ~300 bytes of boot text; at 921600 baud
            that takes about 4 ms, but we also need margin for the
            host to open the port.  3000 ms is safe; lower values
            risk missing the first SUMP command.

endmenu
```
